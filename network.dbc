VERSION ""

NS_ :

BS_:

BU_: DASHBOARD RPM_SENSOR OIL_SENSOR

BO_ 256 RPM_DATA: 2 RPM_SENSOR
 SG_ EngineRPM : 0|16@1+ (1,0) [0|8000] "RPM" DASHBOARD

BO_ 512 OIL_DATA: 3 OIL_SENSOR
 SG_ OilTemperature : 0|8@1+ (1,-40) [-40|215] "C" DASHBOARD
 SG_ OilPressure : 8|16@1+ (0.01,0) [0|10] "bar" DASHBOARD
